## config/west.yml
```yaml
manifest:
  remotes:
    - name: zmkfirmware
      url-base: https://github.com/zmkfirmware
    - name: inorichi
      url-base: https://github.com/inorichi
    - name: keyfreaks
      url-base: https://github.com/kay-yokoyama
    - name: caksoylar
      url-base: https://github.com/caksoylar
    - name: kloir-z
      url-base: https://github.com/kloir-z
    - name: kot149
      url-base: https://github.com/kot149

  projects:
    - name: zmk
      remote: zmkfirmware
      revision: v0.2.1
      import: app/west.yml

    # PMW3610 driver（スクロール加速対応ブランチ）
    - name: zmk-pmw3610-driver
      remote: kloir-z
      revision: scroll-acceleration-feature

    - name: zmk-rgbled-widget
      remote: caksoylar
      revision: v0.3

    - name: zmk-mouse-gesture
      remote: kot149
      revision: v1

  self:
    path: config
```
